# file: GPIO_Register.ioc
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Mcu.Family=STM32F4
Mcu.Name=STM32F407Z(E-G)Tx
Mcu.Package=LQFP144
NVIC.PriorityGroup=NVIC_PRIORITYGROUP_4
ProjectManager.HeapSize=0x200
ProjectManager.StackSize=0x400
ProjectManager.TargetToolchain=STM32CubeIDE
RCC.AHBFreq_Value=16000000
RCC.APB1Freq_Value=16000000
RCC.APB2Freq_Value=16000000
RCC.CortexFreq_Value=16000000
RCC.HSE_VALUE=25000000
RCC.HSI_VALUE=16000000
RCC.LSE_VALUE=32768
RCC.SYSCLKFreq_VALUE=16000000
RCC.VCOOutputFreq_Value=192000000
board=custom

// file: Core/Src/main.c
/* USER CODE BEGIN Header */
/**
  ******************************************************************************
  * @file           : main.c
  * @brief          : Main program body
  ******************************************************************************
  * @attention
  *
  * Copyright (c) 2023 STMicroelectronics.
  * All rights reserved.
  *
  * This software is licensed under terms that can be found in the LICENSE file
  * in the root directory of this software component.
  * If no LICENSE file comes with this software, it is provided AS-IS.
  *
  ******************************************************************************
  */
/* USER CODE END Header */
#include "main.h"

void SystemClock_Config(void);

/* USER CODE BEGIN 0 */
#define AHB1BASE (0x40020000)
#define RCC_ADDRESS (AHB1BASE+0x3800)
#define GPIOF_CLK (*(volatile unsigned int *)(RCC_ADDRESS+0x30))  //AHB1 外设时钟使能寄存器

#define MODER (*(volatile uint32_t *)(AHB1BASE+0x1400))
#define OTYPER (*(volatile uint32_t *)(AHB1BASE+0x1400+0x04))
#define OSPEEDR (*(volatile uint32_t *)(AHB1BASE+0x1400+0x08))
#define PUPDR (*(volatile uint32_t *)(AHB1BASE+0x1400+0x0C))
#define ODR (*(volatile uint32_t *)(AHB1BASE+0x1400+0x14))
/* USER CODE END 0 */

int main(void) {
    /* USER CODE BEGIN 1 */
    GPIOF_CLK |= (1 << 5); //AHB1 外设时钟使能寄存器 设置GPIOF使能
    MODER &= ~(3 << (2 * 9));   //2个一组 第9组清零
    MODER |= (1 << (2 * 9));    //通用输出

    OTYPER &= ~(1 << (1 * 9));  //1个一组 第9组清零
    OTYPER |= (0 << (1 * 9));   //推挽输出

    OSPEEDR &= ~(3 << (2 * 9)); //2个一组 第9组清零
    OSPEEDR |= (0 << (2 * 9));  //2Mhz速度

    PUPDR &= ~(3 << (2 * 9));   //清零
    PUPDR |= (0 << (2 * 9));    //无上下拉

    ODR &= ~(1 << (1 * 9));       //清零 对应引脚输出低电平
    /* USER CODE END 1 */

    /* MCU Configuration--------------------------------------------------------*/

    /* Reset of all peripherals, Initializes the Flash interface and the Systick. */
    HAL_Init();

    /* Configure the system clock */
    SystemClock_Config();

    /* Initialize all configured peripherals */

    /* Infinite loop */
    while (1) {

    }
}

void SystemClock_Config(void) {
    RCC_OscInitTypeDef RCC_OscInitStruct = {0};
    RCC_ClkInitTypeDef RCC_ClkInitStruct = {0};

    /** Configure the main internal regulator output voltage
    */
    __HAL_RCC_PWR_CLK_ENABLE();
    __HAL_PWR_VOLTAGESCALING_CONFIG(PWR_REGULATOR_VOLTAGE_SCALE1);

    /** Initializes the RCC Oscillators according to the specified parameters
    * in the RCC_OscInitTypeDef structure.
    */
    RCC_OscInitStruct.OscillatorType = RCC_OSCILLATORTYPE_HSI;
    RCC_OscInitStruct.HSIState = RCC_HSI_ON;
    RCC_OscInitStruct.HSICalibrationValue = RCC_HSICALIBRATION_DEFAULT;
    RCC_OscInitStruct.PLL.PLLState = RCC_PLL_NONE;
    if (HAL_RCC_OscConfig(&RCC_OscInitStruct) != HAL_OK) {
        Error_Handler();
    }

    /** Initializes the CPU, AHB and APB buses clocks
    */
    RCC_ClkInitStruct.ClockType = RCC_CLOCKTYPE_HCLK | RCC_CLOCKTYPE_SYSCLK
                                  | RCC_CLOCKTYPE_PCLK1 | RCC_CLOCKTYPE_PCLK2;
    RCC_ClkInitStruct.SYSCLKSource = RCC_SYSCLKSOURCE_HSI;
    RCC_ClkInitStruct.AHBCLKDivider = RCC_SYSCLK_DIV1;
    RCC_ClkInitStruct.APB1CLKDivider = RCC_HCLK_DIV1;
    RCC_ClkInitStruct.APB2CLKDivider = RCC_HCLK_DIV1;

    if (HAL_RCC_ClockConfig(&RCC_ClkInitStruct, FLASH_LATENCY_0) != HAL_OK) {
        Error_Handler();
    }
}

void Error_Handler(void) {
    __disable_irq();
    while (1) {
    }
}
